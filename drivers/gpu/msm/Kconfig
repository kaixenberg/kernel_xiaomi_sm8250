## drivers/gpu/msm/Kconfig
```kconfig
# SPDX-License-Identifier: GPL-2.0-only
config QCOM_KGSL
	tristate "Qualcomm Technologies, Inc. 3D Graphics driver"
	depends on ARCH_QCOM
	depends on QCOM_QFPROM
	select GENERIC_ALLOCATOR
	select FW_LOADER
	select PM_DEVFREQ
	select QCOM_SCM
	select DEVFREQ_GOV_SIMPLE_ONDEMAND
	select DEVFREQ_GOV_PERFORMANCE
	select DEVFREQ_GOV_QCOM_ADRENO_TZ
	select DEVFREQ_GOV_QCOM_GPUBW_MON
	select TRACE_GPU_MEM
	help
	  3D graphics driver for the Adreno family of GPUs from QTI.
	  Required to use hardware accelerated OpenGL, compute and Vulkan
	  on QTI targets. This includes power management, memory management,
	  and scheduling for the Adreno GPUs.

config QCOM_ADRENO_DEFAULT_GOVERNOR
	string "devfreq governor for the adreno core"
	default "msm-adreno-tz" if DEVFREQ_GOV_QCOM_ADRENO_TZ
	default "simple_ondemand"
	depends on QCOM_KGSL

config EFFGPU
	bool "Cap the GPU at the Snapdragon 865 frequency"
	depends on QCOM_KGSL
	help
	  Limit the GPU to 587 MHz, the Adreno 650 maximum on Snapdragon 865,
	  instead of 670 MHz on Snapdragon 870. The power level table stays
	  intact, only the highest level allowed changes.

config QCOM_KGSL_IOMMU
	bool
	default y if QCOM_KGSL && (MSM_IOMMU || ARM_SMMU)

config CORESIGHT_ADRENO
	bool
	default y if QCOM_KGSL=y && CORESIGHT=y
```

## kernel/Kconfig.droidspaces
```kconfig
# SPDX-License-Identifier: GPL-2.0

config DROIDSPACES
	bool "Droidspaces container support"
	depends on CGROUPS && NET && NETFILTER && IPV6
	select SYSVIPC
	select POSIX_MQUEUE
	select NAMESPACES
	select PID_NS
	select IPC_NS
	select USER_NS
	select CGROUP_DEVICE
	select CGROUP_NET_PRIO
	select CGROUP_PIDS
	select DEVTMPFS
	select BRIDGE_NETFILTER
	select NF_TABLES
	select NETFILTER_XT_MATCH_ADDRTYPE
	select IP6_NF_NAT
	select IP6_NF_TARGET_MASQUERADE
	select MACVLAN
	help
	  Enable the kernel features the Droidspaces container runtime
	  needs, and prefixed cgroup file names on noprefix mounts.

	  FAIR_GROUP_SCHED is deliberately not selected, as it would change
	  scheduling for the whole device. Without it, the --cpus limit is
	  unavailable.
```
